## configs/wb40n_defconfig
```kconfig
CONFIG_ARM=y
CONFIG_SYS_THUMB_BUILD=y
CONFIG_ARCH_AT91=y
CONFIG_TARGET_WB40N=y
CONFIG_SYS_MALLOC_F_LEN=0x2000
CONFIG_DEFAULT_DEVICE_TREE="at91-wb40n"
CONFIG_DEBUG_UART=y
CONFIG_LOCALVERSION="-wb40"
CONFIG_NAND_BOOT=y
CONFIG_BOOTDELAY=3
CONFIG_USE_BOOTARGS=y
CONFIG_BOOTARGS="console=ttyS0,115200 loglevel=4 rw rootfstype=ubifs root=ubi0:rootfs ubi.mtd=6 init=/usr/sbin/fipsInit.sh fips=0 fips_wifi=0"
CONFIG_USE_BOOTCOMMAND=y
CONFIG_BOOTCOMMAND="nand read 0x22000000 0x000e0000 0x500000; bootm 0x22000000"
# CONFIG_DISPLAY_BOARDINFO is not set
CONFIG_HUSH_PARSER=y
# CONFIG_CMD_CONSOLE is not set
# CONFIG_CMD_ELF is not set
# CONFIG_CMD_FDT is not set
# CONFIG_CMD_GO is not set
# CONFIG_CMD_IMI is not set
# CONFIG_CMD_XIMG is not set
# CONFIG_CMD_MEMORY is not set
# CONFIG_CMD_DM is not set
# CONFIG_CMD_FLASH is not set
# CONFIG_CMD_FPGA is not set
# CONFIG_CMD_LOADB is not set
# CONFIG_CMD_LOADS is not set
CONFIG_CMD_NAND=y
CONFIG_CMD_NAND_TRIMFFS=y
CONFIG_CMD_DHCP=y
# CONFIG_CMD_NFS is not set
CONFIG_CMD_MII=y
CONFIG_CMD_PING=y
CONFIG_CMD_HASH=y
CONFIG_CMD_MTDPARTS=y
CONFIG_MTDIDS_DEFAULT="nand0=atmel_nand"
CONFIG_MTDPARTS_DEFAULT="mtdparts=atmel_nand:128k(at91bs)ro,512k(u-boot)ro,128k(u-boot-env-a),128k(u-boot-env-b),5M(kernel-a),5M(kernel-b),48M(rootfs-a),48M(rootfs-b),21376k(user)"
# CONFIG_PARTITIONS is not set
CONFIG_OF_CONTROL=y
CONFIG_ENV_IS_IN_NAND=y
CONFIG_DM=y
CONFIG_BLK=y
CONFIG_BOOTCOUNT=y
CONFIG_CLK=y
CONFIG_CLK_AT91=y
CONFIG_AT91_UTMI=y
CONFIG_DM_GPIO=y
CONFIG_AT91_GPIO=y
# CONFIG_MMC is not set
CONFIG_NAND=y
CONFIG_DM_ETH=y
CONFIG_MACB=y
CONFIG_PINCTRL=y
CONFIG_PINCTRL_AT91=y
CONFIG_DM_REGULATOR=y
CONFIG_DM_REGULATOR_FIXED=y
CONFIG_DM_SERIAL=y
CONFIG_DEBUG_UART_ATMEL=y
CONFIG_DEBUG_UART_BASE=0xffffee00
CONFIG_DEBUG_UART_CLOCK=132000000
CONFIG_DEBUG_UART_BOARD_INIT=y
CONFIG_ATMEL_USART=y
CONFIG_TIMER=y
CONFIG_ATMEL_PIT_TIMER=y
CONFIG_USE_TINY_PRINTF=y
# CONFIG_REGEX is not set
# CONFIG_EFI_LOADER is not set
```

## configs/wb45n_defconfig
```kconfig
CONFIG_ARM=y
CONFIG_SKIP_LOWLEVEL_INIT=y
CONFIG_ARCH_CPU_INIT=y
CONFIG_SYS_THUMB_BUILD=y
CONFIG_ARCH_AT91=y
CONFIG_SUPPORT_PASSING_ATAGS=y
CONFIG_CMDLINE_TAG=y
CONFIG_TEXT_BASE=0x23f00000
CONFIG_SYS_MALLOC_LEN=0x800000
CONFIG_TARGET_WB45N=y
CONFIG_ATMEL_LEGACY=y
CONFIG_NR_DRAM_BANKS=1
CONFIG_ENV_OFFSET=0xa0000
CONFIG_DM_GPIO=y
CONFIG_DEFAULT_DEVICE_TREE="at91-wb45n"
CONFIG_SYS_PROMPT="U-Boot> "
CONFIG_DM_RESET=y
CONFIG_DEBUG_UART_BASE=0xfffff200
CONFIG_DEBUG_UART_CLOCK=132000000
CONFIG_DEBUG_UART_BOARD_INIT=y
CONFIG_ENV_OFFSET_REDUND=0xc0000
CONFIG_SYS_LOAD_ADDR=0x22000000
CONFIG_DEBUG_UART=y
CONFIG_LOCALVERSION="-wb45n"
CONFIG_LTO=y
# CONFIG_EXPERT is not set
CONFIG_SYS_MONITOR_LEN=524288
CONFIG_FIT=y
CONFIG_FIT_VERBOSE=y
CONFIG_NAND_BOOT=y
CONFIG_BOOTDELAY=3
CONFIG_USE_BOOTARGS=y
CONFIG_BOOTARGS="console=ttyS0,115200 loglevel=4 rw rootfstype=ubifs root=ubi0:rootfs ubi.mtd=6 init=/usr/sbin/fipsInit.sh fips=0 fips_wifi=0"
CONFIG_USE_BOOTCOMMAND=y
CONFIG_BOOTCOMMAND="nand read 0x22000000 0x000e0000 0x00280000; bootm"
# CONFIG_DISPLAY_BOARDINFO is not set
CONFIG_HUSH_PARSER=y
CONFIG_SYS_MAXARGS=32
# CONFIG_CMD_CONSOLE is not set
# CONFIG_CMD_BOOTFLOW is not set
# CONFIG_BOOTM_NETBSD is not set
# CONFIG_BOOTM_PLAN9 is not set
# CONFIG_BOOTM_RTEMS is not set
# CONFIG_BOOTM_VXWORKS is not set
CONFIG_SYS_BOOTM_LEN=0x1000000
# CONFIG_CMD_ELF is not set
# CONFIG_CMD_FDT is not set
# CONFIG_CMD_GO is not set
# CONFIG_CMD_IMI is not set
# CONFIG_CMD_XIMG is not set
# CONFIG_CMD_EXPORTENV is not set
# CONFIG_CMD_IMPORTENV is not set
# CONFIG_CMD_FLASH is not set
# CONFIG_CMD_LOADB is not set
# CONFIG_CMD_LOADS is not set
CONFIG_CMD_NAND=y
CONFIG_CMD_NAND_TRIMFFS=y
# CONFIG_CMD_PINMUX is not set
CONFIG_CMD_DHCP=y
# CONFIG_BOOTP_BOOTPATH is not set
# CONFIG_BOOTP_DNS is not set
# CONFIG_BOOTP_HOSTNAME is not set
# CONFIG_CMD_NFS is not set
CONFIG_CMD_MII=y
CONFIG_CMD_PING=y
CONFIG_CMD_HASH=y
CONFIG_CMD_MTDPARTS=y
CONFIG_CMD_MTDPARTS_SHOW_NET_SIZES=y
CONFIG_MTDIDS_DEFAULT="nand0=atmel_nand"
CONFIG_MTDPARTS_DEFAULT="mtdparts=atmel_nand:128k(at91bs)ro,512k(u-boot)ro,128k(u-boot-env-a),128k(u-boot-env-b),2560k(kernel-a),2560k(kernel-b),38M(rootfs-a),38M(rootfs-b),46208k(user),512k(logs)"
CONFIG_OF_CONTROL=y
CONFIG_ENV_OVERWRITE=y
CONFIG_ENV_IS_IN_NAND=y
CONFIG_SYS_REDUNDAND_ENVIRONMENT=y
CONFIG_DEVRES=y
# CONFIG_BLOCK_CACHE is not set
CONFIG_CLK=y
CONFIG_CLK_AT91=y
CONFIG_AT91_GPIO=y
# CONFIG_MMC is not set
CONFIG_MTD=y
CONFIG_SYS_NAND_DRIVER_ECC_LAYOUT=y
CONFIG_NAND_ATMEL=y
CONFIG_ATMEL_NAND_HW_PMECC=y
CONFIG_PMECC_CAP=4
CONFIG_SYS_NAND_ONFI_DETECTION=y
CONFIG_DM_ETH_PHY=y
CONFIG_MACB=y
CONFIG_PINCTRL=y
CONFIG_PINCTRL_AT91=y
CONFIG_DM_REGULATOR=y
CONFIG_DM_REGULATOR_FIXED=y
CONFIG_DM_SERIAL=y
CONFIG_ATMEL_USART=y
CONFIG_TIMER=y
CONFIG_ATMEL_PIT_TIMER=y
CONFIG_USB=y
CONFIG_DM_USB_GADGET=y
CONFIG_USB_GADGET=y
CONFIG_USB_GADGET_MANUFACTURER="WB45n"
CONFIG_USB_GADGET_VENDOR_NUM=0x0525
CONFIG_USB_GADGET_PRODUCT_NUM=0xA4A2
CONFIG_USB_GADGET_ATMEL_USBA=y
CONFIG_USB_ETHER=y
CONFIG_WATCHDOG_TIMEOUT_MSECS=16000
CONFIG_WDT=y
CONFIG_WDT_AT91=y
# CONFIG_REGEX is not set
CONFIG_LZMA=y
# CONFIG_EFI_LOADER is not set
# CONFIG_TOOLS_LIBCRYPTO is not set
```

## drivers/crypto/Kconfig
```kconfig
menu "Hardware crypto devices"

source drivers/crypto/fsl/Kconfig

if ARCH_AT91 && CPU_V7

config ATMEL_SHA
	bool "Atmel SHA Driver support"
	depends on SHA_HW_ACCEL
	default y
	help
	  Enables the Atmel SHA accelerator.

config ATMEL_TRNG
	bool "Atmel TRNG Driver support"
	default y
	help
	  Enables the Atmel True RNG.

config ATMEL_AES
	bool "Atmel AES Driver support"
	depends on ARCH_AT91
	default y
	help
	  Enables the Atmel AES.

endif

endmenu
```

## drivers/crypto/atmel/Kconfig
```kconfig
config ATMEL_AES
	bool "Atmel AES Engine"
	depends on ARCH_AT91
	depends on CPU_V7A || SAM9X60
	depends on AES
	default y
	help
	  Select this option to enable a driver for using the AES hardware
	  engine in the Microchip/Atmel SoCs.

config ATMEL_SHA
	bool "Atmel Hash Engine"
	depends on ARCH_AT91
	depends on CPU_V7A || SAM9X60
	depends on SHA1 || SHA256 || SHA512
	select SHA_HW_ACCEL
	select SHA_PROG_HW_ACCEL
	select SHA512_HW_ACCEL if SHA512
	default y
	help
	  Select this option to enable a driver for using the SHA hardware
	  engine in the Microchip/Atmel SoCs.

if SPL

config SPL_ATMEL_SHA
	bool "Atmel Hash Engine in SPL"
	depends on ARCH_AT91
	depends on CPU_V7A || SAM9X60
	depends on SPL_SHA1 || SPL_SHA256 || SPL_SHA512
	select SPL_SHA_HW_ACCEL
	select SPL_SHA_PROG_HW_ACCEL
	select SHA512_HW_ACCEL if SPL_SHA512
	default y
	help
	  Select this option to enable a driver for using the SHA hardware
	  engine in the Microchip/Atmel SoCs.

endif
```

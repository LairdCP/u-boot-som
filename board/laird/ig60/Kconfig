## board/laird/ig60/Kconfig
```kconfig
if TARGET_IG60

config SYS_BOARD
	default "ig60"

config SYS_VENDOR
	default "laird"

config SYS_CONFIG_NAME
	default "ig60"

endif
```

## board/laird/som60/Kconfig
```kconfig
if TARGET_SOM60

config SYS_BOARD
	default "som60"

config SYS_VENDOR
	default "laird"

config SYS_CONFIG_NAME
	default "som60"

endif

if TARGET_SOM60X2

config SYS_BOARD
	default "som60"

config SYS_VENDOR
	default "laird"

config SYS_CONFIG_NAME
	default "som60x2"

endif

if TARGET_IG60

config SYS_BOARD
	default "som60"

config SYS_VENDOR
	default "laird"

config SYS_CONFIG_NAME
	default "ig60"

endif

if TARGET_WB50N

config SYS_BOARD
	default "som60"

config SYS_VENDOR
	default "laird"

config SYS_CONFIG_NAME
	default "wb50n"

endif

if TARGET_WB50N_SYSD

config SYS_BOARD
	default "som60"

config SYS_VENDOR
	default "laird"

config SYS_CONFIG_NAME
	default "wb50n_sysd"

endif

config SYS_EEPROM_SETUP
	bool "Run-time EEPROM based Module Configuration"
	default y
	depends on TARGET_SOM60 || TARGET_SOM60X2 || TARGET_IG60
	select DM_I2C
	select SYS_I2C_AT91
	select I2C_EEPROM
	select NVMEM
	select ID_EEPROM
	select SPL_I2C if SUPPORT_SPL
	select SPL_I2C_EEPROM if SUPPORT_SPL
	select SPL_NVMEM if SUPPORT_SPL

config SPL_SYS_MENU
	bool "Board configuration SPL Menu"
	depends on SYS_EEPROM_SETUP
	help
		Enables programming and verification into EEPROM of
		board HW ID and MAC addresses for manufacturing.
		HW ID identifies DRAM type insttalled on the module
		This is required to run prior to initializing DRAM
```

## board/laird/wb40n/Kconfig
```kconfig
if TARGET_WB40N

config SYS_BOARD
	default "wb40n"

config SYS_VENDOR
	default "laird"

config SYS_CONFIG_NAME
	default "wb40n"

endif
```

## board/summit/som60/Kconfig
```kconfig
if TARGET_SOM60 || TARGET_IG60 || TARGET_WB50N || TARGET_WB50N_SYSD

config SYS_BOARD
	default "som60"

config SYS_VENDOR
	default "summit"

config SYS_CONFIG_NAME
	default "ig60" if TARGET_IG60
	default "som60" if TARGET_SOM60
	default "wb50n" if TARGET_WB50N
	default "wb50n_sysd" if TARGET_WB50N_SYSD

config TARGET_WB50N_ALL
	bool
	default y
	depends on TARGET_WB50N || TARGET_WB50N_SYSD

config SYS_EEPROM_SETUP
	bool "Run-time EEPROM based Module Configuration"
	default y
	depends on TARGET_SOM60 || TARGET_IG60
	select DM_I2C
	select SYS_I2C_AT91
	select I2C_EEPROM
	select NVMEM
	select SPL_DM_I2C if SUPPORT_SPL
	select SPL_I2C if SUPPORT_SPL
	select SPL_I2C_EEPROM if SUPPORT_SPL
	select SPL_NVMEM if SUPPORT_SPL

config SPL_SYS_MENU
	bool "Board configuration SPL Menu"
	depends on SUPPORT_SPL
	depends on SYS_EEPROM_SETUP
	select SPL_DISPLAY_PRINT
	help
		Enables programming and verification into EEPROM of
		board HW ID and MAC addresses for manufacturing.
		HW ID identifies DRAM type insttalled on the module
		This is required to run prior to initializing DRAM

config CMD_MAC
	bool "MAC and HW ID commands"
	depends on CMDLINE
	depends on SYS_EEPROM_SETUP
	help
		Enables configuration of MAC and HW ID from the
		command line

endif
```

## board/summit/wb40n/Kconfig
```kconfig
if TARGET_WB40N

config SYS_BOARD
	default "wb40n"

config SYS_VENDOR
	default "summit"

config SYS_CONFIG_NAME
	default "wb40n"

endif
```

## board/summit/wb45n/Kconfig
```kconfig
if TARGET_WB45N

config SYS_BOARD
	default "wb45n"

config SYS_VENDOR
	default "summit"

config SYS_CONFIG_NAME
	default "wb45n"

endif
```

## configs/som60_defconfig
```kconfig
CONFIG_ARM=y
CONFIG_ARCH_AT91=y
CONFIG_TARGET_SOM60=y
CONFIG_SPL_GPIO_SUPPORT=y
CONFIG_SPL_LIBCOMMON_SUPPORT=y
CONFIG_SPL_LIBGENERIC_SUPPORT=y
CONFIG_SYS_MALLOC_F_LEN=0x2000
CONFIG_SPL_SERIAL_SUPPORT=y
CONFIG_SPL_DRIVERS_MISC_SUPPORT=y
CONFIG_SPL_NAND_SUPPORT=y
CONFIG_DEFAULT_DEVICE_TREE="at91-som60"
CONFIG_DEBUG_UART=y
CONFIG_FIT=y
CONFIG_FIT_SIGNATURE=y
CONFIG_FIT_VERBOSE=y
CONFIG_SPL_FIT_SIGNATURE=y
CONFIG_SPL_LOAD_FIT=y
CONFIG_SPL_FIT_SOURCE="board/laird/som60/fit_spl.its"
CONFIG_NAND_BOOT=y
CONFIG_BOOTDELAY=3
CONFIG_USE_BOOTARGS=y
CONFIG_USE_BOOTCOMMAND=y
CONFIG_BOOTCOMMAND="ubi part ubi; run _setbootvol; ubi read 0x21000000 kernel_${bootside}; source 0x21000000:script; bootm"
# CONFIG_DISPLAY_BOARDINFO is not set
CONFIG_SPL=y
# CONFIG_SPL_RAW_IMAGE_SUPPORT is not set
# CONFIG_SPL_LEGACY_IMAGE_SUPPORT is not set
CONFIG_SPL_SYS_MALLOC_SIMPLE=y
CONFIG_SPL_SEPARATE_BSS=y
# CONFIG_SYS_MMCSD_RAW_MODE_U_BOOT_USE_SECTOR is not set
CONFIG_SPL_SHA256_SUPPORT=y
CONFIG_SPL_FIT_IMAGE_TINY=y
CONFIG_SPL_CRYPTO_SUPPORT=y
CONFIG_SPL_HASH_SUPPORT=y
CONFIG_HUSH_PARSER=y
CONFIG_CMD_BOOTZ=y
# CONFIG_CMD_IMI is not set
CONFIG_CMD_DFU=y
# CONFIG_CMD_FLASH is not set
# CONFIG_CMD_FPGA is not set
# CONFIG_CMD_LOADB is not set
# CONFIG_CMD_LOADS is not set
CONFIG_CMD_NAND=y
CONFIG_CMD_NAND_TRIMFFS=y
CONFIG_CMD_DHCP=y
# CONFIG_CMD_NFS is not set
CONFIG_CMD_MII=y
CONFIG_CMD_PING=y
CONFIG_CMD_HASH=y
CONFIG_MTDIDS_DEFAULT="nand0=atmel_nand"
CONFIG_MTDPARTS_DEFAULT="mtdparts=atmel_nand:128k(spl)ro,512k(uboot)ro,128k(env),128k(env_redundant),254M(ubi)"
CONFIG_CMD_UBI=y
# CONFIG_CMD_UBIFS is not set
CONFIG_OF_CONTROL=y
CONFIG_SPL_OF_CONTROL=y
CONFIG_OF_SPL_REMOVE_PROPS="interrupts interrupt-parent dmas dma-names"
CONFIG_ENV_IS_IN_NAND=y
CONFIG_DM=y
CONFIG_SPL_DM=y
CONFIG_SPL_DM_SEQ_ALIAS=y
CONFIG_BLK=y
CONFIG_BOOTCOUNT=y
CONFIG_CLK=y
CONFIG_SPL_CLK=y
CONFIG_CLK_AT91=y
CONFIG_AT91_UTMI=y
CONFIG_AT91_H32MX=y
CONFIG_ATMEL_SHA=y
CONFIG_DFU_NAND=y
CONFIG_DM_GPIO=y
CONFIG_AT91_GPIO=y
# CONFIG_MMC is not set
CONFIG_NAND=y
CONFIG_SYS_NAND_U_BOOT_LOCATIONS=y
CONFIG_SYS_NAND_U_BOOT_OFFS=0x20000
CONFIG_DM_ETH=y
CONFIG_MACB=y
CONFIG_PINCTRL=y
CONFIG_SPL_PINCTRL=y
CONFIG_PINCTRL_AT91=y
CONFIG_DM_SERIAL=y
CONFIG_DEBUG_UART_ATMEL=y
CONFIG_DEBUG_UART_BASE=0xffffee00
CONFIG_DEBUG_UART_CLOCK=132000000
CONFIG_DEBUG_UART_BOARD_INIT=y
CONFIG_ATMEL_USART=y
CONFIG_TIMER=y
CONFIG_SPL_TIMER=y
CONFIG_ATMEL_PIT_TIMER=y
CONFIG_USB=y
CONFIG_USB_GADGET=y
CONFIG_USB_GADGET_MANUFACTURER="SOM60"
CONFIG_USB_GADGET_VENDOR_NUM=0x1337
CONFIG_USB_GADGET_PRODUCT_NUM=0xBEEF
CONFIG_USB_GADGET_ATMEL_USBA=y
CONFIG_USB_GADGET_DOWNLOAD=y
CONFIG_SHA_HW_ACCEL=y
CONFIG_SHA_PROG_HW_ACCEL=y
CONFIG_LZMA=y
CONFIG_LZO=y
# CONFIG_EFI_LOADER is not set
```

## configs/som60sd-wbx3_defconfig
```kconfig
CONFIG_ARM=y
CONFIG_SKIP_LOWLEVEL_INIT=y
CONFIG_ARCH_CPU_INIT=y
CONFIG_SYS_THUMB_BUILD=y
CONFIG_ARCH_AT91=y
CONFIG_SYS_TEXT_BASE=0x21000000
CONFIG_SYS_MALLOC_LEN=0x800000
CONFIG_TARGET_SOM60=y
CONFIG_SPL_GPIO=y
CONFIG_SPL_LIBCOMMON_SUPPORT=y
CONFIG_SPL_LIBGENERIC_SUPPORT=y
CONFIG_NR_DRAM_BANKS=1
CONFIG_DM_GPIO=y
CONFIG_DEFAULT_DEVICE_TREE="at91-som60"
CONFIG_SPL_TEXT_BASE=0x300000
CONFIG_SPL_MMC=y
CONFIG_SPL_SERIAL=y
CONFIG_SPL_STACK_R_ADDR=0x20100000
CONFIG_SPL=y
CONFIG_DEBUG_UART_BASE=0xffffee00
CONFIG_DEBUG_UART_CLOCK=132000000
CONFIG_DEBUG_UART_BOARD_INIT=y
CONFIG_SPL_FS_FAT=y
CONFIG_SPL_LIBDISK_SUPPORT=y
CONFIG_SYS_LOAD_ADDR=0x21200000
CONFIG_DEBUG_UART=y
CONFIG_LOCALVERSION="-som60sd-wbx3
CONFIG_LTO=y
CONFIG_SYS_BOOT_GET_CMDLINE=y
CONFIG_SYS_BARGSIZE=1024
# CONFIG_EXPERT is not set
CONFIG_SPL_IMAGE="spl/boot.bin"
CONFIG_FIT=y
CONFIG_FIT_VERBOSE=y
CONFIG_SPL_FIT_SIGNATURE=y
CONFIG_SPL_FIT_CIPHER=y
CONFIG_SPL_LOAD_FIT=y
CONFIG_SPL_LOAD_FIT_ADDRESS=0x21200000
CONFIG_SPL_FIT_SOURCE="board/laird/som60/fit_spl.its"
# CONFIG_USE_SPL_FIT_GENERATOR is not set
# CONFIG_LEGACY_IMAGE_FORMAT is not set
CONFIG_SD_BOOT=y
CONFIG_BOOTDELAY=-2
CONFIG_USE_BOOTCOMMAND=y
CONFIG_BOOTCOMMAND="source 0x20100000:script"
# CONFIG_DISPLAY_BOARDINFO is not set
CONFIG_ID_EEPROM=y
CONFIG_SPL_MAX_SIZE=0x10000
CONFIG_SPL_PAD_TO=0x0
CONFIG_SPL_HAS_BSS_LINKER_SECTION=y
CONFIG_SPL_BSS_START_ADDR=0x318000
CONFIG_SPL_BSS_MAX_SIZE=0x8000
# CONFIG_SPL_RAW_IMAGE_SUPPORT is not set
CONFIG_SPL_SYS_MALLOC_SIMPLE=y
CONFIG_SPL_STACK_R=y
# CONFIG_SYS_MMCSD_RAW_MODE_U_BOOT_USE_SECTOR is not set
CONFIG_SPL_FIT_IMAGE_TINY=y
CONFIG_SPL_DM_RESET=y
CONFIG_SPL_WATCHDOG=y
CONFIG_HUSH_PARSER=y
CONFIG_SYS_MAXARGS=32
# CONFIG_SYS_XTRACE is not set
# CONFIG_CMD_CONSOLE is not set
# CONFIG_CMD_BOOTFLOW is not set
# CONFIG_BOOTM_NETBSD is not set
# CONFIG_BOOTM_PLAN9 is not set
# CONFIG_BOOTM_RTEMS is not set
# CONFIG_BOOTM_VXWORKS is not set
CONFIG_SYS_BOOTM_LEN=0x1000000
# CONFIG_CMD_ELF is not set
# CONFIG_CMD_FDT is not set
# CONFIG_CMD_GO is not set
# CONFIG_CMD_IMI is not set
# CONFIG_CMD_XIMG is not set
# CONFIG_CMD_MEMORY is not set
# CONFIG_CMD_FLASH is not set
CONFIG_CMD_GPIO=y
# CONFIG_CMD_LOADB is not set
# CONFIG_CMD_LOADS is not set
CONFIG_CMD_NAND=y
CONFIG_CMD_NAND_TRIMFFS=y
# CONFIG_CMD_PINMUX is not set
# CONFIG_CMD_NET is not set
CONFIG_CMD_HASH=y
CONFIG_CMD_FS_GENERIC=y
CONFIG_CMD_MTDPARTS=y
CONFIG_CMD_MTDPARTS_SHOW_NET_SIZES=y
CONFIG_MTDIDS_DEFAULT="nand0=atmel_nand"
CONFIG_MTDPARTS_DEFAULT="mtdparts=atmel_nand:128k(u-boot-spl)ro,1M(u-boot)ro,128k(u-boot-env-a),128k(u-boot-env-b),260224k(ubi)"
CONFIG_CMD_UBI=y
# CONFIG_CMD_UBIFS is not set
CONFIG_DOS_PARTITION=y
CONFIG_OF_CONTROL=y
CONFIG_SPL_OF_CONTROL=y
CONFIG_OF_SPL_REMOVE_PROPS="interrupts interrupt-parent dmas dma-names"
CONFIG_ENV_OVERWRITE=y
CONFIG_ENV_IS_IN_FAT=y
CONFIG_DM=y
CONFIG_SPL_DM=y
CONFIG_SPL_DM_SEQ_ALIAS=y
CONFIG_DEVRES=y
CONFIG_BOOTCOUNT_LIMIT=y
CONFIG_BOOTCOUNT_ENV=y
CONFIG_CLK=y
CONFIG_SPL_CLK=y
CONFIG_CLK_AT91=y
CONFIG_AT91_GPIO=y
CONFIG_DM_I2C=y
CONFIG_SYS_I2C_AT91=y
CONFIG_I2C_EEPROM=y
# CONFIG_MMC_QUIRKS is not set
# CONFIG_MMC_HW_PARTITIONING is not set
CONFIG_GENERIC_ATMEL_MCI=y
CONFIG_MTD=y
CONFIG_MTD_RAW_NAND=y
CONFIG_SYS_NAND_DRIVER_ECC_LAYOUT=y
CONFIG_NAND_ATMEL=y
CONFIG_ATMEL_NAND_HW_PMECC=y
CONFIG_PMECC_CAP=8
CONFIG_SYS_NAND_ONFI_DETECTION=y
CONFIG_SYS_NAND_U_BOOT_LOCATIONS=y
CONFIG_SYS_NAND_U_BOOT_OFFS=0x20000
CONFIG_MTD_UBI_FASTMAP=y
CONFIG_MTD_UBI_FASTMAP_AUTOCONVERT=1
CONFIG_PINCTRL=y
CONFIG_SPL_PINCTRL=y
CONFIG_PINCTRL_AT91=y
CONFIG_DM_REGULATOR=y
CONFIG_DM_REGULATOR_FIXED=y
CONFIG_DM_RESET=y
CONFIG_DM_RNG=y
CONFIG_RNG_ATMEL=y
CONFIG_DM_SERIAL=y
CONFIG_ATMEL_USART=y
CONFIG_SYSRESET=y
CONFIG_SPL_SYSRESET=y
CONFIG_SYSRESET_AT91=y
CONFIG_TIMER=y
CONFIG_SPL_TIMER=y
CONFIG_ATMEL_PIT_TIMER=y
CONFIG_SPL_ATMEL_PIT_TIMER=y
CONFIG_WATCHDOG_TIMEOUT_MSECS=6000
CONFIG_WDT=y
CONFIG_WDT_AT91=y
# CONFIG_REGEX is not set
CONFIG_LIB_HW_RAND=y
CONFIG_ZSTD=y
```

## configs/som60x2sd-wbx3_defconfig
```kconfig
CONFIG_ARM=y
CONFIG_SKIP_LOWLEVEL_INIT=y
CONFIG_ARCH_CPU_INIT=y
CONFIG_SYS_THUMB_BUILD=y
CONFIG_ARCH_AT91=y
CONFIG_SYS_TEXT_BASE=0x21000000
CONFIG_SYS_MALLOC_LEN=0x800000
CONFIG_SYS_MALLOC_F_LEN=0x2000
CONFIG_TARGET_SOM60X2=y
CONFIG_SPL_GPIO=y
CONFIG_SPL_LIBCOMMON_SUPPORT=y
CONFIG_SPL_LIBGENERIC_SUPPORT=y
CONFIG_NR_DRAM_BANKS=1
CONFIG_ENV_OFFSET=0x120000
CONFIG_DM_GPIO=y
CONFIG_DEFAULT_DEVICE_TREE="at91-som60x2"
CONFIG_SPL_TEXT_BASE=0x300000
CONFIG_SPL_MMC=y
CONFIG_SPL_SERIAL=y
CONFIG_SPL_DRIVERS_MISC=y
CONFIG_SPL_STACK_R_ADDR=0x20100000
CONFIG_SPL=y
CONFIG_DEBUG_UART_BOARD_INIT=y
CONFIG_DEBUG_UART_BASE=0xffffee00
CONFIG_DEBUG_UART_CLOCK=132000000
CONFIG_ENV_OFFSET_REDUND=0x140000
CONFIG_SPL_FS_FAT=y
CONFIG_SPL_LIBDISK_SUPPORT=y
CONFIG_DEBUG_UART=y
CONFIG_LOCALVERSION="-som60x2sd-wbx3"
CONFIG_LTO=y
# CONFIG_EXPERT is not set
CONFIG_SYS_LOAD_ADDR=0x21200000
CONFIG_FIT=y
CONFIG_FIT_VERBOSE=y
CONFIG_SPL_FIT_FULL_CHECK=y
CONFIG_SPL_LOAD_FIT=y
CONFIG_SPL_LOAD_FIT_ADDRESS=0x21200000
CONFIG_SPL_FIT_SOURCE="board/laird/som60/fit_spl.its"
# CONFIG_USE_SPL_FIT_GENERATOR is not set
# CONFIG_LEGACY_IMAGE_FORMAT is not set
CONFIG_SD_BOOT=y
# CONFIG_AUTOBOOT is not set
CONFIG_USE_BOOTARGS=y
CONFIG_USE_BOOTCOMMAND=y
CONFIG_BOOTCOMMAND="source 0x20100000:script"
# CONFIG_DISPLAY_BOARDINFO is not set
CONFIG_ID_EEPROM=y
# CONFIG_SPL_RAW_IMAGE_SUPPORT is not set
CONFIG_SPL_SYS_MALLOC_SIMPLE=y
CONFIG_SPL_STACK_R=y
# CONFIG_SYS_MMCSD_RAW_MODE_U_BOOT_USE_SECTOR is not set
CONFIG_SPL_FIT_IMAGE_TINY=y
CONFIG_SPL_WATCHDOG=y
CONFIG_HUSH_PARSER=y
# CONFIG_CMD_CONSOLE is not set
# CONFIG_CMD_ELF is not set
# CONFIG_CMD_FDT is not set
# CONFIG_CMD_GO is not set
# CONFIG_CMD_IMI is not set
# CONFIG_CMD_XIMG is not set
# CONFIG_CMD_MEMORY is not set
# CONFIG_CMD_FLASH is not set
# CONFIG_CMD_LOADB is not set
# CONFIG_CMD_LOADS is not set
CONFIG_CMD_NAND=y
CONFIG_CMD_NAND_TRIMFFS=y
# CONFIG_CMD_PINMUX is not set
CONFIG_CMD_DHCP=y
# CONFIG_BOOTP_BOOTPATH is not set
# CONFIG_BOOTP_DNS is not set
# CONFIG_BOOTP_HOSTNAME is not set
# CONFIG_CMD_NFS is not set
CONFIG_CMD_MII=y
CONFIG_CMD_PING=y
CONFIG_CMD_HASH=y
CONFIG_CMD_FS_GENERIC=y
CONFIG_CMD_MTDPARTS=y
CONFIG_CMD_MTDPARTS_SHOW_NET_SIZES=y
CONFIG_MTDIDS_DEFAULT="nand0=atmel_nand"
CONFIG_MTDPARTS_DEFAULT="mtdparts=atmel_nand:128k(u-boot-spl)ro,1M(uboot)ro,128k(u-boot-env-a),128k(u-boot-env-b),522368k(ubi)"
CONFIG_CMD_UBI=y
# CONFIG_CMD_UBIFS is not set
CONFIG_DOS_PARTITION=y
CONFIG_OF_CONTROL=y
CONFIG_SPL_OF_CONTROL=y
CONFIG_OF_SPL_REMOVE_PROPS="interrupts interrupt-parent dmas dma-names"
CONFIG_ENV_OVERWRITE=y
CONFIG_ENV_IS_IN_NAND=y
CONFIG_SYS_REDUNDAND_ENVIRONMENT=y
CONFIG_NET_RANDOM_ETHADDR=y
CONFIG_DM=y
CONFIG_SPL_DM=y
CONFIG_SPL_DM_SEQ_ALIAS=y
CONFIG_DEVRES=y
CONFIG_BOOTCOUNT_LIMIT=y
CONFIG_BOOTCOUNT_ENV=y
CONFIG_CLK=y
CONFIG_SPL_CLK=y
CONFIG_CLK_AT91=y
CONFIG_AT91_GPIO=y
CONFIG_DM_I2C=y
CONFIG_SYS_I2C_AT91=y
CONFIG_SPL_MISC=y
CONFIG_I2C_EEPROM=y
# CONFIG_MMC_QUIRKS is not set
# CONFIG_MMC_HW_PARTITIONING is not set
CONFIG_GENERIC_ATMEL_MCI=y
CONFIG_MTD=y
CONFIG_MTD_RAW_NAND=y
CONFIG_SYS_NAND_DRIVER_ECC_LAYOUT=y
CONFIG_NAND_ATMEL=y
CONFIG_ATMEL_NAND_HW_PMECC=y
CONFIG_PMECC_CAP=8
CONFIG_SYS_NAND_ONFI_DETECTION=y
CONFIG_SYS_NAND_U_BOOT_LOCATIONS=y
CONFIG_SYS_NAND_U_BOOT_OFFS=0x20000
CONFIG_MTD_UBI_FASTMAP=y
CONFIG_MTD_UBI_FASTMAP_AUTOCONVERT=1
CONFIG_PHY_MICREL=y
CONFIG_PHY_MICREL_KSZ90X1=y
CONFIG_PHY_MICREL_KSZ8XXX=y
CONFIG_PHY_MSCC=y
CONFIG_DM_ETH=y
CONFIG_DM_ETH_PHY=y
CONFIG_MACB=y
CONFIG_PINCTRL=y
CONFIG_SPL_PINCTRL=y
CONFIG_PINCTRL_AT91=y
CONFIG_DM_REGULATOR=y
CONFIG_DM_REGULATOR_FIXED=y
CONFIG_DM_RNG=y
CONFIG_RNG_ATMEL=y
CONFIG_DM_SERIAL=y
CONFIG_ATMEL_USART=y
CONFIG_TIMER=y
CONFIG_SPL_TIMER=y
CONFIG_ATMEL_PIT_TIMER=y
CONFIG_USB=y
# CONFIG_SPL_DM_USB is not set
CONFIG_DM_USB_GADGET=y
CONFIG_USB_GADGET=y
CONFIG_USB_GADGET_MANUFACTURER="SOM60"
CONFIG_USB_GADGET_VENDOR_NUM=0x0525
CONFIG_USB_GADGET_PRODUCT_NUM=0xA4A2
CONFIG_USB_GADGET_ATMEL_USBA=y
CONFIG_USB_ETHER=y
CONFIG_WATCHDOG_TIMEOUT_MSECS=6000
CONFIG_WDT=y
CONFIG_WDT_AT91=y
# CONFIG_REGEX is not set
CONFIG_LIB_HW_RAND=y
CONFIG_ZSTD=y
# CONFIG_EFI_LOADER is not set
```

/*
 * at91-som60-uart.dts - Device Tree file for the SOM60 with only debug UART
 *
 *  Copyright (C) 2018-2020 Laird Connectivity,
 *		  2018 Ben Whitten <ben.whitten@lairdconnect.com>
 *		  2021 Boris Krasnovskiy <boris.krasnovskiy@lairdconnect.com>
 *
 * Licensed under GPLv2 or later.
 */

/dts-v1/;

#include "at91-som60.dtsi"

&dbgu {
	u-boot,dm-pre-reloc;
	status = "okay";
};

// SPDX-License-Identifier: LicenseRef-Ezurio-Clause
/*
 * at91-som60.dts - Device Tree file for the DVK SOM60 board
 *
 * Copyright (C) 2018 Ezurio
 */

/dts-v1/;

#include "at91-som60.dtsi"
#include "at91-som60_dvk.dtsi"

/ {
	model = "Ezurio DVK SOM60";
	compatible = "summit,dvk-som60", "summit,som60", "atmel,sama5d36", "atmel,sama5d3", "atmel,sama5";
};

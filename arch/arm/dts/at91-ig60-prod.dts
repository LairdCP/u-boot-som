/*
 * at91-ig60-prod.dts - Device Tree file for the Sentrius IG60
 *
 *  Copyright (C) 2021 Laird Connectivity,
 *		  2021 Boris Krasnpovskiy <boris.krasnovskiy@lairdconnect.com>
 *
 * Licensed under GPLv2 or later.
 */

#include "at91-ig60.dts"

/ {
    config {
        bootdelay = <(-2)>;
    };
};

// SPDX-License-Identifier: LicenseRef-Ezurio-Clause
/*
 * at91-ig60ll.dts - Device Tree file for the Sentrius IG60 Laird Linux
 *
 * Copyright (C) 2019 Ezurio
 */

/dts-v1/;

#include "at91-som60.dtsi"
#include "at91-ig60.dtsi"

/ {
	model = "Sentrius IG60 LL";
	compatible = "summit,ig60ll", "summit,som60", "atmel,sama5d36", "atmel,sama5d3", "atmel,sama5";
};


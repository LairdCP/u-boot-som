// SPDX-License-Identifier: GPL-2.0
/*
 * at91-wb50n_sysd-uart - Device Tree file for wb50n board with only debug uart enabled
 *
 * Copyright (C) 2019-2020 Laird Connectivity
 *
 */

/dts-v1/;

#include "at91-wb50n_sysd.dtsi"

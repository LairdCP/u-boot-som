/*
 * at91-som60x2.dts - Device Tree file for the DVK SOM60 x2 board
 *
 *  Copyright (C) 2019 Laird,
 *		  2018 Boris Krasnovskiy <boris.krasnovskiy@lairdtech.com>
 *
 * Licensed under GPLv2 or later.
 */

/dts-v1/;

#include "at91-som60x2.dtsi"
#include "at91-som60_dvk.dtsi"

/ {
	model = "Laird DVK SOM60 x2";
	compatible = "laird,dvk-som60x2", "laird,som60x2", "atmel,sama5d36", "atmel,sama5d3", "atmel,sama5";
};

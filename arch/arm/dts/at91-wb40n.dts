// SPDX-License-Identifier: LicenseRef-Ezurio-Clause
/*
 * at91-wb40n.dts - Device Tree file for WB40NBT board
 *
 * Copyright (C) 2020 Ezurio
 */

/dts-v1/;

#include "at91-wb40n.dtsi"

&macb0 {
	status = "okay";
};

&dbgu {
	status = "okay";
};

&usb1 {
	status = "okay";
};
